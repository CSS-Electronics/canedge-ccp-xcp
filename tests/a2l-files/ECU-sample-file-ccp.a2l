/* SAMPLE CCP FILE */
/* @@@@ File header based on CANAPE_VERSION XX X XX @@@@ */
/* @@@@ File is generated from XX                   @@@@ */ ASAP2_VERSION 1 61
/begin PROJECT XYZ100 ""
/begin MODULE CPP ""
/begin MOD_PAR "" /end MOD_PAR
/begin MOD_COMMON "" BYTE_ORDER MSB_FIRST ALIGNMENT_BYTE 1 ALIGNMENT_WORD 2 ALIGNMENT_LONG 4 ALIGNMENT_FLOAT32_IEEE 4 ALIGNMENT_FLOAT64_IEEE 8 ALIGNMENT_INT64 8 /end MOD_COMMON
/begin IF_DATA ASAP1B_CCP
 /begin SOURCE "DAQ List" 0 0 /begin QP_BLOB 0x00 LENGTH 0x28 FIRST_PID 0x00 /end QP_BLOB /end SOURCE
 /begin SOURCE "DAQ List" 0 0 /begin QP_BLOB 0x01 LENGTH 0x28 FIRST_PID 0x28 /end QP_BLOB /end SOURCE
 /begin SOURCE "DAQ List" 0 0 /begin QP_BLOB 0x02 LENGTH 0x28 FIRST_PID 0x50 /end QP_BLOB /end SOURCE
 /begin RASTER "HST" "HST" 0x01 3 5 /end RASTER
 /begin RASTER "MST" "MST" 0x02 3 20 /end RASTER
 /begin RASTER "EVENT" "EVENT" 0x0E 1000 0 /end RASTER
 /begin RASTER "cyclic" "cyclic" 0x0F 1000 0 /end RASTER
 /begin SEED_KEY "seedkey1.DLL" "seedkey1.DLL" "seedkey1.DLL" /end SEED_KEY
 /begin TP_BLOB 0x0201 0x0206 0x8CF12504 0x8CF1242B 0x0500 0x01 DAQ_MODE BURST CONSISTENCY ODT ADDRESS_EXTENSION DAQ BYTES_ONLY OPTIONAL_CMD 0x05 OPTIONAL_CMD 0x08 OPTIONAL_CMD 0x0F OPTIONAL_CMD 0x12 OPTIONAL_CMD 0x13 OPTIONAL_CMD 0x23 OPTIONAL_CMD 0x22 BAUDRATE 0x0F4240 SAMPLE_POINT 0x4B SAMPLE_RATE 0x01 BTL_CYCLES 0x08 SJW 0x02 SYNC_EDGE SINGLE /end TP_BLOB
/end IF_DATA
/begin MEASUREMENT Measurement1 "comment" UWORD REVOLUTION_SCL 0 0 0 3000 ECU_ADDRESS 0x500186A3 FORMAT "%.3" SYMBOL_LINK "Measurement1_Out.spd" 0 /end MEASUREMENT
/begin MEASUREMENT Measurement2 "comment" UWORD REVOLUTION_SCL 0 0 0 3000 ECU_ADDRESS 0x5001378B FORMAT "%.3" SYMBOL_LINK "Measurement2_Out.spd" 0 /end MEASUREMENT
/begin MEASUREMENT Measurement3 "comment" UWORD REVOLUTION_SCL 0 0 0 3000 ECU_ADDRESS 0x5001471F FORMAT "%.3" SYMBOL_LINK "Measurement3_Out.spd" 0 /end MEASUREMENT
/begin MEASUREMENT Measurement4 "comment" UWORD REVOLUTION_SCL 0 0 0 3000 ECU_ADDRESS 0x50012C61 FORMAT "%.3" SYMBOL_LINK "Measurement4_Out.spd" 0 /end MEASUREMENT
/begin MEASUREMENT Measurement5 "comment" UWORD REVOLUTION_SCL 0 0 0 3000 ECU_ADDRESS 0x50015D44 FORMAT "%.3" SYMBOL_LINK "Measurement5_Out.spd" 0 /end MEASUREMENT
/begin COMPU_METHOD REVOLUTION_SCL "" IDENTICAL "%.0" "RPM   " /end COMPU_METHOD
/end MODULE
/end PROJECT
