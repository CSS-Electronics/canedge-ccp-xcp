VERSION "CCP_DBC"

NS_ :

BS_:

BU_: Logger

BO_ 2364613675 DTO: 8 Logger
  SG_ DTOPID M : 0|8@1+ (1,0) [0|255] ""  Logger
  SG_ Measurement1 m0 : 15|16@0+ (1,0) [0|3000] ""  Logger
  SG_ Measurement2 m0 : 31|16@0+ (1,0) [0|3000] ""  Logger
  SG_ Measurement3 m0 : 47|16@0+ (1,0) [0|3000] ""  Logger
  SG_ Measurement4 m1 : 15|16@0+ (1,0) [0|3000] ""  Logger
  SG_ Measurement5 m40 : 15|16@0+ (1,0) [0|3000] ""  Logger

CM_ SG_ 2364613675 Measurement1 "Measurement1 | comment";
CM_ SG_ 2364613675 Measurement2 "Measurement2 | comment";
CM_ SG_ 2364613675 Measurement3 "Measurement3 | comment";
CM_ SG_ 2364613675 Measurement4 "Measurement4 | comment";
CM_ SG_ 2364613675 Measurement5 "Measurement5 | comment";

BA_DEF_ "BusType" STRING ;
BA_DEF_ "ProtocolType" STRING ;
BA_DEF_ BO_ "VFrameFormat" ENUM "StandardCAN","ExtendedCAN","reserved","reserved","reserved","reserved","reserved","reserved","reserved","reserved","reserved","reserved","reserved","reserved","StandardCAN_FD","ExtendedCAN_FD";
BA_DEF_ SG_ "SignalIgnore" INT 0 1;
BA_DEF_DEF_ "BusType" "";
BA_DEF_DEF_ "ProtocolType" "";
BA_DEF_DEF_ "VFrameFormat" "ExtendedCAN";
BA_DEF_DEF_ "SignalIgnore" 0;
BA_ "BusType" "CAN";
BA_ "SignalIgnore" SG_ 2364613675 DTOPID 1;
